/*
 * Device tree overlay to enable CAN on Allwinner A20 Boards
 */
/dts-v1/;
/plugin/;

/ {
    compatible = "allwinner,sun7i-a20";

  /* enable CAN controller */
  fragment@0 {
    target = <&can0>;
    __overlay__ {
      pinctrl-names = "default";
      pinctrl-0 = <&can0_pins_a>;
      status = "okay";
    };
  };
};

